float log_table[101] = {
100
,109.647819614319
,120.226443461741
,131.825673855641
,144.543977074593
,158.489319246111
,173.780082874938
,190.546071796325
,208.929613085404
,229.086765276777
,251.188643150958
,275.422870333817
,301.995172040202
,331.131121482591
,363.078054770101
,398.107170553497
,436.515832240166
,478.630092322639
,524.807460249772
,575.439937337157
,630.957344480193
,691.830970918936
,758.577575029184
,831.763771102671
,912.01083935591
,1000
,1096.47819614319
,1202.26443461741
,1318.25673855641
,1445.43977074593
,1584.89319246111
,1737.80082874938
,1905.46071796325
,2089.29613085404
,2290.86765276777
,2511.88643150958
,2754.22870333817
,3019.95172040202
,3311.31121482591
,3630.78054770101
,3981.07170553497
,4365.15832240166
,4786.30092322638
,5248.07460249772
,5754.39937337157
,6309.57344480193
,6918.30970918936
,7585.77575029184
,8317.63771102671
, 9120.1083935591
,10000
,10964.7819614319
,12022.6443461741
,13182.5673855641
,14454.3977074593
,15848.9319246111
,17378.0082874938
,19054.6071796325
,20892.9613085404
,22908.6765276777
,25118.8643150958
,27542.2870333816
,30199.5172040202
,33113.1121482591
,36307.8054770102
,39810.7170553497
,43651.5832240166
,47863.0092322638
,52480.7460249772
,57543.9937337157
,63095.7344480193
,69183.0970918936
,75857.7575029184
,83176.3771102671
,91201.083935591
,100000
,109647.819614319
,120226.443461741
,131825.673855641
,144543.977074593
,158489.319246111
,173780.082874938
,190546.071796325
,208929.613085404
,229086.765276777
,251188.643150958
,275422.870333816
,301995.172040202
,331131.121482591
,363078.054770101
,398107.170553497
,436515.832240166
,478630.092322638
,524807.460249772
,575439.937337157
,630957.344480193
,691830.970918936
,758577.575029184
,831763.771102671
,912010.83935591
,1000000};


