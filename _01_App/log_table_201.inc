float log_table[201] = {
100
,104.71285480509
,109.647819614319
,114.815362149688
,120.226443461741
,125.892541179417
,131.825673855641
,138.038426460289
,144.543977074593
,151.356124843621
,158.489319246111
,165.958690743756
,173.780082874938
,181.970085860998
,190.546071796325
,199.526231496888
,208.929613085404
,218.776162394955
,229.086765276777
,239.883291901949
,251.188643150958
,263.026799189538
,275.422870333817
,288.403150312661
,301.995172040202
,316.227766016838
,331.131121482591
,346.736850452532
,363.078054770101
,380.189396320561
,398.107170553497
,416.869383470335
,436.515832240166
,457.088189614875
,478.630092322639
,501.187233627272
,524.807460249772
,549.540873857625
,575.439937337157
,602.559586074358
,630.957344480193
,660.693448007596
,691.830970918936
,724.43596007499
,758.577575029184
,794.328234724281
,831.763771102671
,870.963589956081
,912.01083935591
,954.992586021436
,1000
,1047.1285480509
,1096.47819614319
,1148.15362149688
,1202.26443461741
,1258.92541179417
,1318.25673855641
,1380.38426460289
,1445.43977074593
,1513.56124843621
,1584.89319246111
,1659.58690743756
,1737.80082874938
,1819.70085860998
,1905.46071796325
,1995.26231496888
,2089.29613085404
,2187.76162394955
,2290.86765276777
,2398.83291901949
,2511.88643150958
,2630.26799189538
,2754.22870333817
,2884.03150312661
,3019.95172040202
,3162.27766016838
,3311.31121482591
,3467.36850452532
,3630.78054770101
,3801.89396320561
,3981.07170553497
,4168.69383470335
,4365.15832240166
,4570.88189614875
,4786.30092322638
,5011.87233627273
,5248.07460249772
,5495.40873857625
,5754.39937337157
,6025.59586074358
,6309.57344480193
,6606.93448007596
,6918.30970918936
,7244.35960074991
,7585.77575029184
,7943.28234724282
,8317.63771102671
,8709.63589956081
,9120.1083935591
,9549.92586021436
,10000
,10471.285480509
,10964.7819614319
,11481.5362149688
,12022.6443461741
,12589.2541179417
,13182.5673855641
,13803.8426460288
,14454.3977074593
,15135.6124843621
,15848.9319246111
,16595.8690743756
,17378.0082874938
,18197.0085860998
,19054.6071796325
,19952.6231496888
,20892.9613085404
,21877.6162394955
,22908.6765276777
,23988.3291901949
,25118.8643150958
,26302.6799189538
,27542.2870333816
,28840.3150312661
,30199.5172040202
,31622.7766016838
,33113.1121482591
,34673.6850452532
,36307.8054770102
,38018.9396320561
,39810.7170553497
,41686.9383470336
,43651.5832240166
,45708.8189614875
,47863.0092322638
,50118.7233627273
,52480.7460249772
,54954.0873857625
,57543.9937337157
,60255.9586074358
,63095.7344480193
,66069.3448007596
,69183.0970918936
,72443.5960074989
,75857.7575029184
,79432.8234724282
,83176.3771102671
,87096.358995608
,91201.083935591
,95499.2586021437
,100000
,104712.85480509
,109647.819614319
,114815.362149688
,120226.443461741
,125892.541179417
,131825.673855641
,138038.426460288
,144543.977074593
,151356.124843621
,158489.319246111
,165958.690743756
,173780.082874938
,181970.085860998
,190546.071796325
,199526.231496888
,208929.613085404
,218776.162394955
,229086.765276777
,239883.291901949
,251188.643150958
,263026.799189538
,275422.870333816
,288403.150312661
,301995.172040202
,316227.766016838
,331131.121482591
,346736.850452532
,363078.054770101
,380189.396320561
,398107.170553497
,416869.383470336
,436515.832240166
,457088.189614875
,478630.092322638
,501187.233627272
,524807.460249772
,549540.873857625
,575439.937337157
,602559.586074358
,630957.344480193
,660693.448007596
,691830.970918936
,724435.960074991
,758577.575029184
,794328.234724282
,831763.771102671
,870963.589956081
,912010.83935591
,954992.586021437
,1000000};



